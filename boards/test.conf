## boards/test.conf
```kconfig
# Enable Bluetooth Low Energy (BLE) support
CONFIG_ZMK_BLE=y
CONFIG_ZMK_SPLIT_BLE=y

# Enable USB support
CONFIG_USB=y
CONFIG_USB_DEVICE_STACK=y
CONFIG_USB_DEVICE_PRODUCT="test"

# Configure the keyboard name for BLE advertising
CONFIG_BT_DEVICE_NAME="test"
CONFIG_BT_DEVICE_APPEARANCE=961

# Power-saving settings
CONFIG_ZMK_SLEEP=y
CONFIG_ZMK_IDLE_TIMEOUT=30000  # Idle timeout in milliseconds (30 seconds)

# Matrix scanning
CONFIG_ZMK_MATRIX_SCAN_INTERVAL_US=5000  # Scanning interval in microseconds

# Enable battery monitoring (if applicable)
CONFIG_ZMK_BATTERY=y

# Debugging settings (optional, can remove in production)
CONFIG_LOG=y
CONFIG_LOG_DEFAULT_LEVEL=3
```
